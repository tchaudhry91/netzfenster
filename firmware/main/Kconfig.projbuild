## firmware/main/Kconfig.projbuild
```kconfig
menu "Netzfenster Configuration"

    config NETZF_WIFI_SSID
        string "WiFi SSID"
        default "YOUR_SSID"
        help
            The SSID of the WiFi network to connect to.

    config NETZF_WIFI_PASSWORD
        string "WiFi Password"
        default "YOUR_PASSWORD"
        help
            The password of the WiFi network.

    config NETZF_SERVER
        string "Netzfenster Server URL"
        default "http://192.168.29.203:8989"
        help
            Base URL of the netzfenster HTTP server, e.g. http://<host>:8989.
            The firmware appends /frame?viewport=...&rows=...&cols=...

endmenu
```
